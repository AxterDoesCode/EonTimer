## firmware/esp32/esp32_macro_runner/sdkconfig.defaults
```kconfig
# Classic BT HID
CONFIG_BT_ENABLED=y
CONFIG_BT_CLASSIC_ENABLED=y
CONFIG_BT_HID_ENABLED=y
CONFIG_BT_HID_DEVICE_ENABLED=y
CONFIG_BT_BLE_ENABLED=n
CONFIG_BTDM_CTRL_MODE_BR_EDR_ONLY=y

# Increase main task stack for BT coexistence
CONFIG_ESP_MAIN_TASK_STACK_SIZE=8192

# Partition table (NVS needs space)
CONFIG_PARTITION_TABLE_SINGLE_APP_LARGE=y
```
